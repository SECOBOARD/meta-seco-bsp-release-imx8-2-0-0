## conf/machine/seco-sm-qd.conf
```bitbake
#@TYPE: Machine
#@NAME: IMX8MQ-SECO-C12 SMARC board
#@SOC: i.MX8MQ i.MX8M
#@DESCRIPTION: Machine configuration for IMX8MQ-SECO-C12 SMARC board
#@MAINTAINER: Mathanraj Murugan <mathan.raj@seco.com>

require conf/machine/include/imx-base.inc
require conf/machine/include/arm/arch-arm64.inc

MACHINEOVERRIDES =. "mx8:mx8mq:"

MACHINE_FEATURES += " pci wifi bluetooth optee"

MACHINE_SOCARCH_FILTER_append_mx8mq = " virtual/libopenvg virtual/libgles1 virtual/libgles2 virtual/egl virtual/mesa virtual/libgl virtual/libg2d"

UBOOT_CONFIG ??= "sd"
UBOOT_CONFIG[sd] = "imx8mq_seco_c12_defconfig,sdcard"
SPL_BINARY = "spl/u-boot-spl.bin"

PREFERRED_PROVIDER_u-boot = "u-boot-seco"
PREFERRED_PROVIDER_virtual/bootloader_seco-sm-qd ?= "u-boot-seco"
PREFERRED_PROVIDER_virtual/bootloader_mx8mq = "u-boot-seco"
PREFERRED_PROVIDER_virtual/bootloader = "u-boot-seco"
PREFERRED_PROVIDER_u-boot_mx8mq = "u-boot-seco"
PREFERRED_VERSION_u-boot-seco = "2017.03"


PREFERRED_PROVIDER_virtual/kernel_seco-sm-qd = "linux-seco"
PREFERRED_PROVIDER_virtual/kernel_mx8 = "linux-seco"
PREFERRED_PROVIDER_virtual/kernel_mx8mq = "linux-seco"
PREFERRED_PROVIDER_virtual/kernel = "linux-seco"
PREFERRED_VERSION_linux-seco = "4.9.88"

KERNEL_DEVICETREE = "seco/fsl-imx8mq-seco-c12.dtb"
KERNEL_OVERLAYDEVICETREE = "seco/overlays/fsl-imx8mq-seco-c12-dual-display.dtbo seco/overlays/fsl-imx8mq-seco-c12-lcdif-sn65dsi84.dtbo seco/overlays/fsl-imx8mq-seco-c12-wilink.dtbo"

DDR_FIRMWARE_NAME = "lpddr4_pmu_train_1d_imem.bin lpddr4_pmu_train_1d_dmem.bin lpddr4_pmu_train_2d_imem.bin lpddr4_pmu_train_2d_dmem.bin"

UBOOT_DTB_NAME = "fsl-imx8mq-seco-c12.dtb"

IMXBOOT_TARGETS = "flash_evk flash_evk_no_hdmi"

SERIAL_CONSOLE = "115200 ttymxc0"

IMAGE_BOOTLOADER = "imx-boot"

BOOT_SPACE = "65536"

UBOOT_SUFFIX = "bin"

UBOOT_MAKE_TARGET = ""

IMX_BOOT_SEEK = "33"

LOADADDR = ""

OPTEE_BIN_EXT = " 8mq "

KERNEL_IMAGETYPE = "Image"

PREFERRED_PROVIDER_virtual/mesa = ""
```
